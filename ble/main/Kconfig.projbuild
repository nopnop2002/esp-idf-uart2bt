## ble/main/Kconfig.projbuild
```kconfig
menu "Application Configuration"

	config GPIO_RANGE_MAX
		int
		default 33 if IDF_TARGET_ESP32
		default 48 if IDF_TARGET_ESP32S3
		default 18 if IDF_TARGET_ESP32C2
		default 19 if IDF_TARGET_ESP32C3
		default 30 if IDF_TARGET_ESP32C6

	config UART_TX_GPIO
		int "UART TX GPIO number"
		range 0 GPIO_RANGE_MAX
		default 17 if IDF_TARGET_ESP32
		default  2 if IDF_TARGET_ESP32S3
		default  1 # C3 and others
		help
			GPIO number (IOxx) to UART TX.
			Some GPIOs are used for other purposes (flash connections, etc.).
			GPIOs 35-39 are input-only so cannot be used as outputs.

	config UART_RX_GPIO
		int "UART RX GPIO number"
		range 0 GPIO_RANGE_MAX
		default 16 if IDF_TARGET_ESP32
		default  1 if IDF_TARGET_ESP32S3
		default  0 # C3 and others
		help
			GPIO number (IOxx) to UART RX.
			Some GPIOs are used for other purposes (flash connections, etc.).
			GPIOs 35-39 are input-only so cannot be used as outputs.

	config UART_BAUD_RATE
		int "UART communication speed"
		range 1200 115200
		default 115200
		help
			UART communication speed.

endmenu
```

## ble/sdkconfig.defaults
```kconfig
#
# Bluetooth
#
CONFIG_BT_ENABLED=y
CONFIG_BT_BLE_42_FEATURES_SUPPORTED=y
CONFIG_BT_LE_HCI_EVT_BUF_SIZE=257
#CONFIG_BTDM_CTRL_MODE_BLE_ONLY=y
#CONFIG_BTDM_CTRL_MODE_BR_EDR_ONLY=n
#CONFIG_BTDM_CTRL_MODE_BTDM=n
```

## bluedroid_ble/sdkconfig.defaults
```kconfig
# Override some defaults so BT stack is enabled

#
# Bluetooth
#
CONFIG_BT_ENABLED=y
CONFIG_BT_BLUEDROID_ENABLED=y
CONFIG_BT_NIMBLE_ENABLED=n

#
# Controller Options
#
CONFIG_BTDM_CTRL_MODE_BLE_ONLY=y
CONFIG_BTDM_CTRL_MODE_BR_EDR_ONLY=n
CONFIG_BTDM_CTRL_MODE_BTDM=n
CONFIG_BT_BLE_42_FEATURES_SUPPORTED=y
```

## classic_bt/main/Kconfig.projbuild
```kconfig
menu "Application Configuration"

	config GPIO_RANGE_MAX
		int
		default 33 if IDF_TARGET_ESP32

	config UART_TX_GPIO
		int "UART TX GPIO number"
		range 0 GPIO_RANGE_MAX
		default 17 if IDF_TARGET_ESP32
		help
			GPIO number (IOxx) to UART TX.
			Some GPIOs are used for other purposes (flash connections, etc.).
			GPIOs 35-39 are input-only so cannot be used as outputs.

	config UART_RX_GPIO
		int "UART RX GPIO number"
		range 0 GPIO_RANGE_MAX
		default 16 if IDF_TARGET_ESP32
		help
			GPIO number (IOxx) to UART RX.
			Some GPIOs are used for other purposes (flash connections, etc.).
			GPIOs 35-39 are input-only so cannot be used as outputs.

	config UART_BAUD_RATE
		int "UART communication speed"
		range 1200 115200
		default 115200
		help
			UART communication speed.

endmenu
```

## classic_bt/sdkconfig.defaults
```kconfig
# Override some defaults so BT stack is enabled

#
# Bluetooth
#
CONFIG_BT_ENABLED=y

#
# Bluedroid Options
#
CONFIG_BT_CLASSIC_ENABLED=y
CONFIG_BT_BLE_ENABLED=n
CONFIG_BT_SPP_ENABLED=y

#
# Controller Options
#
CONFIG_BTDM_CTRL_MODE_BLE_ONLY=n
CONFIG_BTDM_CTRL_MODE_BR_EDR_ONLY=y
CONFIG_BTDM_CTRL_MODE_BTDM=n
```
